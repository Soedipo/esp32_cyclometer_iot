#include <Arduino.h>
#include <stdbool.h>

// FIREBASE
#include <WiFi.h>
#include <Firebase_ESP_Client.h>
#include <WiFi.h>
#include <Firebase_ESP_Client.h>
// Provide the token generation process info.
#include "addons/TokenHelper.h"
// Provide the RTDB payload printing info and other helper functions.
#include "addons/RTDBHelper.h"

// OLED Display
#include <Wire.h>
#include <Adafruit_GFX.h>
#include <Adafruit_SSD1306.h>
#include <Fonts/FreeMonoBold12pt7b.h> // Add a custom font.
Adafruit_SSD1306 display(128, 64);

#define HALL 2
#define LED LED_BUILTIN
#define DATABASE_URL "myurl"
#define API_KEY "myapi"

// Insert your network credentials
#define WIFI_SSID "mywifi"
#define WIFI_PASSWORD "mypass"

void interruptFunction();
void startCycling();
void timeCount();
void firebaseSetInt(String, int);
void firebaseSetFloat(String, float);
void firebaseSetString(String, String);
float firebaseGetFloat(String);

// FIREBASE
// Define Firebase Data object
FirebaseData fbdo;

FirebaseAuth auth;
FirebaseConfig config;

unsigned long sendDataPrevMillis = 0;
unsigned long sendDataPrevMillis1 = 0;
unsigned long sendDataPrevMillis2 = 0;
unsigned long sendDataPrevMillis3 = 0;
int count = 0;
bool signupOK = false;

String rpmTestDirectory = String("test/rpm");
String speedFirebaseDirectory = String("realtimeData/speed");
String distanceFirebaseDirectory = String("realtimeData/distance");
String averageSpeedFirebaseDirectory = String("realtimeData/averageSpeed");
String maxSpeedFirebaseDirectory = String("realtimeData/maxSpeed");
String timeFirebaseDirectory = String("realtimeData/elapsedTime");
String diameterFirebaseDirectory = String("realtimeData/diameter");
String diameterDumpFirebaseDirectory = String("realtimeData/diameterDump");

String diameterStringValue = "";
char diameterToChar[10];
// OLED variables
const unsigned char arduino_icon[] PROGMEM = {
    // 'cyclopps', 128x64px
    0x01, 0x80, 0x00, 0x00, 0x00, 0xc0, 0x00, 0x00, 0x07, 0xe0, 0x00, 0x00, 0x00, 0x00, 0x00, 0xc0,
    0x0f, 0xf0, 0x60, 0x06, 0x07, 0xf8, 0x18, 0x00, 0x1f, 0xf8, 0x1f, 0xfc, 0x1f, 0xfc, 0x07, 0xf8,
    0x3e, 0x78, 0x70, 0x0e, 0x0f, 0x1c, 0x18, 0x00, 0x70, 0x1c, 0x1f, 0xfe, 0x1f, 0xfe, 0x0f, 0x3c,
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    0x00, 0x00, 0x00, 0x00, 0x00, 0x00, 0x00, 0x00, 0x00, 0x00, 0x00, 0x00, 0x00, 0x00, 0x00, 0x00};

// Time Variables
unsigned long endTime = 0;
unsigned long startTime = 0;
unsigned long revolutionStartTime = 0;
unsigned long currentTimeCount = 0;
unsigned long elapsedTime = 0;
int timeSeconds = 0;
int timeMinutes = 0;
int timeHours = 0;
String timeDisplay = "";

// Speed Variables
int revolutions = 0;
int currentRevolution = 0;
int rpm = 0; // max value 32,767 16 bit
float diameter = 0;
float speed = 0;
float averageSpeed = 0;
float maxSpeed = 0;
float wheelCircumference = 0;
double distance = 0;

int resetCounter = 0;

void setup()
{
  Serial.begin(115200);
  pinMode(HALL, INPUT_PULLUP); // set pin to input

  // OLED SETUP
  if (!display.begin(SSD1306_SWITCHCAPVCC, 0x3C))
  { // Address 0x3D for 128x64
    Serial.println(F("SSD1306 allocation failed"));
    for (;;)
      ;
  }

  display.begin(SSD1306_SWITCHCAPVCC, 0x3C); // Initialize display with the I2C address of 0x3C.
  display.clearDisplay();                    // Clear the buffer.
  display.setTextColor(WHITE);               // Set color of the text to white.
  display.setRotation(0);                    // Set orientation. Goes from 0, 1, 2 or 3.
  display.setTextWrap(false);                // By default, long lines of text are set to automatically “wrap” back to the leftmost column.
                                             // To override this behavior (so text will run off the right side of the display - useful for
                                             // scrolling marquee effects), use setTextWrap(false). The normal wrapping behavior is restored
                                             // with setTextWrap(true).
  display.dim(0);
  // display.setCursor(0, 25); // Set brightness (0 is maximum and 1 is a little dim).
  // display.println("~ Welcome to CYCLOPS ~");
  display.drawBitmap(0, 25, arduino_icon, 128, 64, WHITE);
  display.display();
  delay(1500);
  display.clearDisplay();
  delay(1000);

  // WIFI SETUP
  WiFi.begin(WIFI_SSID, WIFI_PASSWORD);
  Serial.print("Connecting to Wi-Fi");
  String connectString = "Connecting";
  display.println(connectString);
  while (WiFi.status() != WL_CONNECTED)
  {
    Serial.print(".");
    if (resetCounter < 3)
    {
      display.clearDisplay();
      display.setCursor(0, 25);
      connectString = connectString + ".";
      display.println(connectString);
      resetCounter++;
    }
    else
    {
      display.clearDisplay();
      display.setCursor(0, 25);
      connectString = "Connecting";
      display.println(connectString);
      resetCounter = 0;
    }

    display.display();
    delay(300);
  }
  delay(700);
  display.clearDisplay();
  delay(500);
  display.setCursor(0, 10);
  display.println("Connected ^_^");

  Serial.println();
  Serial.print("Connected with IP: ");
  Serial.println(WiFi.localIP());
  Serial.println();

  display.display();
  // FIREBASE SETUP
  /* Assign the api key (required) */
  config.api_key = API_KEY;

  /* Assign the RTDB URL (required) */
  config.database_url = DATABASE_URL;

  display.setCursor(0, 25);

  /* Sign up */
  if (Firebase.signUp(&config, &auth, "", ""))
  {
    display.println("Firebase success");
    Serial.println("ok");
    signupOK = true;
  }
  else
  {
    String firebaseErrorMessage = config.signer.signupError.message.c_str();

    Serial.printf("%s\n", firebaseErrorMessage);

    display.println(firebaseErrorMessage);
  }
  display.display();

  /* Assign the callback function for the long runfng token generation task */
  config.token_status_callback = tokenStatusCallback; // see addons/TokenHelper.h

  Firebase.begin(&config, &auth);
  Firebase.reconnectWiFi(true);

  delay(1000);
}

void loop()
{
  revolutions = 0;
  rpm = 0;
  speed = 0;

  startTime = millis();

  attachInterrupt(digitalPinToInterrupt(HALL), interruptFunction, RISING);
  delay(1000);
  detachInterrupt(2);

  diameter = firebaseGetFloat(diameterFirebaseDirectory);
  currentTimeCount = firebaseGetFloat(timeFirebaseDirectory);
  Serial.println(diameter);
  Serial.println(currentTimeCount);

  wheelCircumference = PI * diameter * 0.00001; // CALCULATE THE WHEEL CIRCUMFERENCE

  /* CALCULATE THE NEEDS */
  if (revolutions > 0)
  {
    currentRevolution += revolutions;
    distance = currentRevolution * wheelCircumference; // calculates distance

    rpm = (max(1, revolutions) * 60000) / elapsedTime; // calculates rpm
    speed = wheelCircumference * rpm * 60;             // Calculates speed
    if (maxSpeed < speed)                              // define the max speed
    {
      maxSpeed = speed;
    }
  }
  averageSpeed = distance * 3.6 / currentTimeCount;

  String speedString = speed + String(" Km/H"); // Create a character array of 10 characters
  String disString = distance + String(" Km");  // Create a character array of 10 characters

  // OUPUT to OLED display
  display.clearDisplay();               // Clear the display so we can refresh.
  display.setFont(&FreeMonoBold12pt7b); // Set a custom font.
  display.setTextSize(0);               // Set text size. We are using a custom font so you should always use the text size of 0.
  display.setCursor(0, 25);             // (x,y).
  display.println(speedString);         // Text or value to print.

  // Print variable with right alignment:
  display.setCursor(0, 55);   // (x,y).
  display.println(disString); // Text or value to print.
  display.display();          // Print everything we set previously

  // SEND DATA TO FIREBASE
  if (startTime - sendDataPrevMillis > 500)
  {
    firebaseSetFloat(speedFirebaseDirectory, speed);
    firebaseSetFloat(maxSpeedFirebaseDirectory, maxSpeed);
    sendDataPrevMillis = startTime;
  }

  if (startTime - sendDataPrevMillis2 > 4000)
  {
    firebaseSetFloat(distanceFirebaseDirectory, distance);
    sendDataPrevMillis2 = startTime;
  }
  
  if (startTime - sendDataPrevMillis3 > 8000)
  {
    firebaseSetFloat(averageSpeedFirebaseDirectory, averageSpeed);
    sendDataPrevMillis3 = startTime;
  }
}

void interruptFunction() // interrupt service routine
{
  revolutions++;
  elapsedTime = millis() - revolutionStartTime;
  revolutionStartTime = millis();
}

void firebaseSetInt(String databaseDirectory, int value)
{
  // Write an Int number on the database path test/int
  if (Firebase.RTDB.setInt(&fbdo, databaseDirectory, value))
  {
    Serial.println("PASSED");
  }
  else
  {
    Serial.println("FAILED");
    Serial.println("REASON: " + fbdo.errorReason());
  }
}

void firebaseSetFloat(String databaseDirectory, float value)
{
  // Write an Int number on the database path test/int
  if (Firebase.RTDB.setFloat(&fbdo, databaseDirectory, value))
  {
    Serial.println("PASSED");
  }
  else
  {
    Serial.println("FAILED");
    Serial.println("REASON: " + fbdo.errorReason());
  }
}

void firebaseSetString(String databaseDirectory, String value)
{
  // Write an Int number on the database path test/int
  if (Firebase.RTDB.setString(&fbdo, databaseDirectory, value))
  {
    Serial.println("PASSED");
  }
  else
  {
    Serial.println("FAILED");
    Serial.println("REASON: " + fbdo.errorReason());
  }
}

float firebaseGetFloat(String databaseDirectory)
{
  if (Firebase.RTDB.getFloat(&fbdo, databaseDirectory))
  {
    float floatValue = fbdo.floatData();
    return floatValue;
  }
  else
  {
    Serial.println(fbdo.errorReason());
    return 0;
  }
}
